## esp32/LebensSpur/HW/sdkconfig.defaults
```kconfig
# ============================================
# LebensSpur - ESP32-C6 SDK Configuration
# ============================================

# --- Target ---
CONFIG_IDF_TARGET="esp32c6"

# --- Flash (Dahili 4MB) ---
CONFIG_ESPTOOLPY_FLASHSIZE_4MB=y
CONFIG_ESPTOOLPY_FLASHSIZE="4MB"

# --- Partition Table ---
CONFIG_PARTITION_TABLE_CUSTOM=y
CONFIG_PARTITION_TABLE_CUSTOM_FILENAME="partitions.csv"

# --- OTA ---
CONFIG_BOOTLOADER_APP_ROLLBACK_ENABLE=y

# --- SPI Flash (Harici 32MB - W25Q256) ---
CONFIG_SPI_FLASH_SUPPORT_BIST=y

# --- WiFi ---
CONFIG_ESP_WIFI_SOFTAP_SUPPORT=y

# --- HTTP Server ---
CONFIG_HTTPD_MAX_REQ_HDR_LEN=1024
CONFIG_HTTPD_MAX_URI_LEN=512

# --- LWIP (max_open_sockets=13 icin: 13+3=16 socket gerekli) ---
CONFIG_LWIP_MAX_SOCKETS=16

# --- TLS/SSL (SMTP icin) ---
CONFIG_ESP_TLS_USING_MBEDTLS=y

# --- NVS ---
CONFIG_NVS_ENCRYPTION=n

# --- Log Level ---
CONFIG_LOG_DEFAULT_LEVEL_INFO=y
CONFIG_LOG_DEFAULT_LEVEL=3

# --- SKAPP Library additions ---

# USB Serial/JTAG CLI (sk_transport_usb)
CONFIG_ESP_CONSOLE_USB_SERIAL_JTAG=y
CONFIG_USB_SERIAL_JTAG_ENABLED=y
CONFIG_ESP_CONSOLE_HISTORY_BUFFER_SIZE=2048

# NimBLE (sk_transport_ble)
CONFIG_BT_ENABLED=y
CONFIG_BT_NIMBLE_ENABLED=y
CONFIG_BT_NIMBLE_SM_SC=y
CONFIG_BT_NIMBLE_SM_BONDING=y
CONFIG_BT_NIMBLE_EXT_ADV=n
CONFIG_BT_NIMBLE_MAX_CONNECTIONS=2

# mbedtls primitives (sk_auth)
CONFIG_MBEDTLS_HMAC_SHA256_C=y
CONFIG_MBEDTLS_ECDH_C=y
CONFIG_MBEDTLS_ECP_DP_CURVE25519_ENABLED=y
```

## esp32/skapp-library/sdkconfig.defaults
```kconfig
# SKAPP Faz 0 starter defaults.
CONFIG_IDF_TARGET="esp32c6"
CONFIG_ESPTOOLPY_FLASHSIZE_4MB=y

# USB Serial/JTAG carries the boot log (and the CLI once sk_transport_usb is wired).
CONFIG_ESP_CONSOLE_USB_SERIAL_JTAG=y
CONFIG_USB_SERIAL_JTAG_ENABLED=y
CONFIG_ESP_CONSOLE_HISTORY_BUFFER_SIZE=2048

# Bootloader rollback enabled — required by sk_ota when added.
CONFIG_BOOTLOADER_APP_ROLLBACK_ENABLE=y

# TLS certificate bundle — required by sk_api outbound HTTPS to verify
# popular CA roots (Let's Encrypt, GoDaddy, etc.) without per-endpoint
# cert config. Telegram, IFTTT and most modern APIs work out of the box.
CONFIG_MBEDTLS_CERTIFICATE_BUNDLE=y
CONFIG_MBEDTLS_CERTIFICATE_BUNDLE_DEFAULT_FULL=y

# NVS without encryption — fine for dev boards; enable on production.
CONFIG_NVS_ENCRYPTION=n

CONFIG_LOG_DEFAULT_LEVEL_INFO=y
CONFIG_LOG_DEFAULT_LEVEL=3
```
